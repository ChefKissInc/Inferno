## hw/core/Kconfig
```kconfig
config EMPTY_SLOT
    bool

config PTIMER
    bool

config GENERIC_LOADER
    bool
    default y

config OR_IRQ
    bool

config REGISTER
    bool

config SPLIT_IRQ
    bool
```

## hw/usb/Kconfig
```kconfig
config USB
    bool

config USB_EHCI
    bool
    select USB

config USB_EHCI_SYSBUS
    bool
    select USB_EHCI

config USB_XHCI
    bool
    select USB

config USB_XHCI_SYSBUS
    bool
    select USB_XHCI

config USB_DWC2
    bool
    select USB

config USB_HUB
    bool
    default y
    depends on USB

config USB_DWC3
    bool
    select USB_XHCI_SYSBUS
    select REGISTER

config USB_UPLINK
    bool
    default y
    depends on USB

config APPLE_OTG
    bool
    select USB_UPLINK
    select USB_DWC2
    depends on APPLE_SOC

config APPLE_TYPEC
    bool
    select USB_UPLINK
    select USB_DWC3
    depends on APPLE_SOC
```
